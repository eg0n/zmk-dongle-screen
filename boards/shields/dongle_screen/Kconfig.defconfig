## boards/shields/dongle_screen/Kconfig.defconfig
```kconfig
# Copyright (c) 2024 The ZMK Contributors
# SPDX-License-Identifier: MIT

if SHIELD_DONGLE_SCREEN

choice ZMK_DISPLAY_STATUS_SCREEN
    default ZMK_DISPLAY_STATUS_SCREEN_CUSTOM
endchoice

config ZMK_DISPLAY_STATUS_SCREEN_CUSTOM
    select LV_USE_LABEL
    select LV_USE_IMG
    select LV_USE_CANVAS
    select LV_USE_ANIMIMG
    select LV_USE_ANIMATION
    select LV_USE_LINE
    select LV_USE_GRID
    select ZMK_WPM
    imply ZMK_HID_INDICATORS

config ZMK_DONGLE_DISPLAY_DONGLE_BATTERY
    bool "Show also the battery level of the dongle"
    depends on BT && (!ZMK_SPLIT_BLE || ZMK_SPLIT_ROLE_CENTRAL)

choice ZMK_DISPLAY_WORK_QUEUE
    default ZMK_DISPLAY_WORK_QUEUE_DEDICATED
endchoice

choice ST7789V_PIXEL_FORMAT
	default ST7789V_RGB565
endchoice

config LV_Z_VDB_SIZE
    default 50

config LV_Z_DOUBLE_VDB
    default y

config LV_Z_FLUSH_THREAD
    default y

config LV_Z_MEM_POOL_SIZE
    default 16384

config LV_DPI_DEF
    default 261

config LV_Z_BITS_PER_PIXEL
	default 16

choice LV_COLOR_DEPTH
	default LV_COLOR_DEPTH_16
endchoice

config LV_COLOR_16_SWAP
	default y


config PWM
    default y

config LED_PWM
    default y

config ZMK_BACKLIGHT
    default y

config DONGLE_SCREEN_HORIZONTAL
    bool "Screen orientation"
    default y
    help
      Orientation of the screen. In default it is horizontal (laying on the side)

config DONGLE_SCREEN_FLIPPED
    bool "Screen flip option"
    default n
    help
      Should the screen orientation should be flipped in horizontal or vertical orientation?

config DONGLE_SCREEN_WPM_ACTIVE
    bool "WPM Widget active"
    default y
    help
      Whether WPM Widget should be active

config DONGLE_SCREEN_ALS_ACTIVE
    bool "ALS Widget active"
    default n
    help
      Whether ALS Widget should be active

config DONGLE_SCREEN_MODIFIER_ACTIVE
    bool "Modifier Widget active"
    default y
    help
      Whether Modifier Widget should be active

config DONGLE_SCREEN_LAYER_ACTIVE
    bool "Layer Widget active"
    default y
    help
      Whether Layer Widget should be active

config DONGLE_SCREEN_CONNECTION_ACTIVE
    bool "Connection Widget active"
    default y
    help
      Whether Connection Widget should be active

config DONGLE_SCREEN_BATTERY_ACTIVE
    bool "Battery Widget active"
    default y
    help
      Whether Battery Widget should be active

config DONGLE_SCREEN_ANIMATION_ACTIVE
    bool "Animation active"
    default y
    help
      Whether animation should be active

config DONGLE_SCREEN_AMBIENT_LIGHT
    bool "Enable automatic brightness via ambient light sensor"
    default y
    select ZMK_AMBIENT_LIGHT
    help
      Uses the ZMK core ambient light service (CONFIG_ZMK_AMBIENT_LIGHT)
      to sample the APDS9960 and drive screen brightness automatically
      via zmk_backlight_set_brt(). The sensor and its zmk-als alias are
      declared in the xiao_ble board overlay.

      Idle blanking and brightness key behaviors are handled by
      CONFIG_ZMK_BACKLIGHT_AUTO_OFF_IDLE and the &ds_bl behavior
      respectively — no custom thread or hardcoded keycodes needed.

config DONGLE_SCREEN_ALS_LUX_MAX
    int "Lux ceiling for auto-brightness (tune for sensor placement)"
    default 15360
    range 10 65535
    depends on DONGLE_SCREEN_AMBIENT_LIGHT
    help
      Lux value that maps to 100% brightness. Lower this if the sensor
      sits behind translucent plastic or the enclosure attenuates light.

config DONGLE_SCREEN_ANIMATION_INVERTED
    bool "Invert display colors"
    default y

config DONGLE_SCREEN_ANIMATION_MS
    int "Brightness fade animation duration (milliseconds)"
    default 960
    range 100 3000
    help
      Maximum duration of a backlight brightness fade animation.
      Shorter fades (small brightness delta) are proportionally
      faster; this value is the ceiling for a 100% delta.

      Set to 0 to disable smooth fading (instant brightness changes).
      Applies to ALS auto-brightness updates and &ds_bl key presses.

endif # SHIELD_DONGLE_SCREEN
```

## dts/bindings/behaviors/zmk,behavior-dongle-screen-bl.yaml
```yaml
# Copyright (c) 2024 The ZMK Contributors
# SPDX-License-Identifier: MIT

description: Dongle screen brightness behavior

compatible: "zmk,behavior-dongle-screen-bl"

include: two_param.yaml
```
